## boards/shields/macropad15/Kconfig.defconfig
```kconfig
# Copyright (c) 2026 The Macropad15 Authors
# SPDX-License-Identifier: MIT

if SHIELD_MACROPAD15

config ZMK_KEYBOARD_NAME
    default "Macropad15"

if ZMK_DISPLAY

config I2C
    default y

config SSD1306
    default y

# Man hinh mono 128x64
if LVGL

config LV_Z_VDB_SIZE
    default 64

config LV_DPI_DEF
    default 148

config LV_Z_BITS_PER_PIXEL
    default 1

choice LV_COLOR_DEPTH
    default LV_COLOR_DEPTH_1
endchoice

endif # LVGL

endif # ZMK_DISPLAY

endif # SHIELD_MACROPAD15
```

## boards/shields/macropad15/Kconfig.shield
```kconfig
# Copyright (c) 2026 The Macropad15 Authors
# SPDX-License-Identifier: MIT

config SHIELD_MACROPAD15
	def_bool $(shields_list_contains,macropad15)
```

## dts/bindings/behaviors/zmk,behavior-lcycle.yaml
```yaml
description: |
  Chuyen vong layer moi lan bam: Base -> Numpad -> Media -> Nokia ...
  (theo thu tu trong property "layers", cac gia tri la layer index)

compatible: "zmk,behavior-lcycle"

include: zero_param.yaml

properties:
  layers:
    type: array
    required: true
    description: Danh sach layer index de chuyen vong
```

## dts/bindings/behaviors/zmk,behavior-nokia-multitap.yaml
```yaml
description: |
  Nokia multitap: bam lien tiep cung phim trong cua so multitap de doi ky tu
  (1abc, 2def, ..., 9yz, 0 va khoang cach, . , ? !).
  param1: 1..9 = chu so, 0 = so 0 + khoang cach, 10 = dau . , ? !

compatible: "zmk,behavior-nokia-multitap"

include: one_param.yaml
```

## dts/bindings/behaviors/zmk,behavior-tap-hold-key.yaml
```yaml
description: |
  Bam ngan = phim 1, bam giu (qua tapping term) = phim 2.
  Vi du: &th_key KP_MINUS KP_DIVIDE (bam "-", giu "/")

compatible: "zmk,behavior-tap-hold-key"

include: two_param.yaml

properties:
  tapping-term-ms:
    type: int
    default: 200
    description: Thoi gian phan biet bam ngan va bam giu (ms)
```
